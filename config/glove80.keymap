/*
 * Copyright (c) 2020 The ZMK Contributors
 * Copyright (c) 2023 Innaworks Development Limited, trading as MoErgo
 *
 * SPDX-License-Identifier: MIT
 */
/* THIS FILE WAS GENERATED BY GLOVE80 LAYOUT EDITOR
 *
 * This file was generated automatically. You may or may not want to
 * edit it directly.
 */

#include <behaviors.dtsi>
#include <dt-bindings/zmk/bt.h>
#include <dt-bindings/zmk/keys.h>
#include <dt-bindings/zmk/outputs.h>
#include <dt-bindings/zmk/rgb.h>

/* On demand includes */
/* Automatically generated layer name #define */

#define LAYER_Base 0
#define LAYER_MacOS 1
#define LAYER_Typing 2
#define LAYER_Lower 3
#define LAYER_Magic 4
#define LAYER_Cursor 5
#define LAYER_Symbol 6
#define LAYER_Gaming 7

/* To deal with the situation where there is no Lower layer, to keep &lower happy */

#ifndef LAYER_Lower

#define LAYER_Lower 0

#

endif {
    /* Custom Device-tree */
    /* Glove80 system behavior & macros */

    /

    behaviors {
        // For the "layer" key, it'd nice to be able to use it as either a shift or a toggle.
        // Configure it as a tap dance, so the first tap (or hold) is a &mo and the second tap is a &to

        lower: lower {
            compatible = "zmk,behavior-tap-dance";
            label = "LAYER_TAP_DANCE";
            #binding-cells = <0>;
            tapping-term-ms = <200>;
            bindings = <&mo LAYER_Lower>, <&to LAYER_Lower>;
        };
    };
};

/ {
    macros {
        rgb_ug_status_macro: rgb_ug_status_macro {
            label = "RGB_UG_STATUS";
            compatible = "zmk,behavior-macro";
            #binding-cells = <0>;
            bindings = <&rgb_ug RGB_STATUS>;
        };
    };
};

/ {
    #ifdef BT_DISC_CMD

    behaviors {
        bt_0: bt_0 {
            compatible = "zmk,behavior-tap-dance";
            label = "BT_0";
            #binding-cells = <0>;
            tapping-term-ms = <200>;
            bindings = <&bt_select_0>, <&bt BT_DISC 0>;
        };

        bt_1: bt_1 {
            compatible = "zmk,behavior-tap-dance";
            label = "BT_1";
            #binding-cells = <0>;
            tapping-term-ms = <200>;
            bindings = <&bt_select_1>, <&bt BT_DISC 1>;
        };

        bt_2: bt_2 {
            compatible = "zmk,behavior-tap-dance";
            label = "BT_2";
            #binding-cells = <0>;
            tapping-term-ms = <200>;
            bindings = <&bt_select_2>, <&bt BT_DISC 2>;
        };

        bt_3: bt_3 {
            compatible = "zmk,behavior-tap-dance";
            label = "BT_3";
            #binding-cells = <0>;
            tapping-term-ms = <200>;
            bindings = <&bt_select_3>, <&bt BT_DISC 3>;
        };
    };

    macros {
        bt_select_0: bt_select_0 {
            label = "BT_SELECT_0";
            compatible = "zmk,behavior-macro";
            #binding-cells = <0>;
            bindings = <&out OUT_BLE &bt BT_SEL 0>;
        };

        bt_select_1: bt_select_1 {
            label = "BT_SELECT_1";
            compatible = "zmk,behavior-macro";
            #binding-cells = <0>;
            bindings = <&out OUT_BLE &bt BT_SEL 1>;
        };

        bt_select_2: bt_select_2 {
            label = "BT_SELECT_2";
            compatible = "zmk,behavior-macro";
            #binding-cells = <0>;
            bindings = <&out OUT_BLE &bt BT_SEL 2>;
        };

        bt_select_3: bt_select_3 {
            label = "BT_SELECT_3";
            compatible = "zmk,behavior-macro";
            #binding-cells = <0>;
            bindings = <&out OUT_BLE &bt BT_SEL 3>;
        };
    };

    #else

    macros {
        bt_0: bt_0 {
            label = "BT_0";
            compatible = "zmk,behavior-macro";
            #binding-cells = <0>;
            bindings = <&out OUT_BLE &bt BT_SEL 0>;
        };

        bt_1: bt_1 {
            label = "BT_1";
            compatible = "zmk,behavior-macro";
            #binding-cells = <0>;
            bindings = <&out OUT_BLE &bt BT_SEL 1>;
        };

        bt_2: bt_2 {
            label = "BT_2";
            compatible = "zmk,behavior-macro";
            #binding-cells = <0>;
            bindings = <&out OUT_BLE &bt BT_SEL 2>;
        };

        bt_3: bt_3 {
            label = "BT_3";
            compatible = "zmk,behavior-macro";
            #binding-cells = <0>;
            bindings = <&out OUT_BLE &bt BT_SEL 3>;
        };
    };

    #endif
};

/ {
    behaviors {
        magic: magic {
            compatible = "zmk,behavior-hold-tap";
            label = "MAGIC_HOLD_TAP";
            #binding-cells = <2>;
            flavor = "tap-preferred";
            tapping-term-ms = <200>;
            bindings = <&mo>, <&rgb_ug_status_macro>;
        };
    };
};

/* #define for key positions */

#define POS_LH_T1 52
#define POS_LH_T2 53
#define POS_LH_T3 54
#define POS_LH_T4 69
#define POS_LH_T5 70
#define POS_LH_T6 71
#define POS_LH_C1R2 15
#define POS_LH_C1R3 27
#define POS_LH_C1R4 39
#define POS_LH_C1R5 51
#define POS_LH_C2R1 4
#define POS_LH_C2R2 14
#define POS_LH_C2R3 26
#define POS_LH_C2R4 38
#define POS_LH_C2R5 50
#define POS_LH_C2R6 68
#define POS_LH_C3R1 3
#define POS_LH_C3R2 13
#define POS_LH_C3R3 25
#define POS_LH_C3R4 37
#define POS_LH_C3R5 49
#define POS_LH_C3R6 67
#define POS_LH_C4R1 2
#define POS_LH_C4R2 12
#define POS_LH_C4R3 24
#define POS_LH_C4R4 36
#define POS_LH_C4R5 48
#define POS_LH_C4R6 66
#define POS_LH_C5R1 1
#define POS_LH_C5R2 11
#define POS_LH_C5R3 23
#define POS_LH_C5R4 35
#define POS_LH_C5R5 47
#define POS_LH_C5R6 65
#define POS_LH_C6R1 0
#define POS_LH_C6R2 10
#define POS_LH_C6R3 22
#define POS_LH_C6R4 34
#define POS_LH_C6R5 46
#define POS_LH_C6R6 64
#define POS_RH_T1 57
#define POS_RH_T2 56
#define POS_RH_T3 55
#define POS_RH_T4 74
#define POS_RH_T5 73
#define POS_RH_T6 72
#define POS_RH_C1R2 16
#define POS_RH_C1R3 28
#define POS_RH_C1R4 40
#define POS_RH_C1R5 58
#define POS_RH_C2R1 5
#define POS_RH_C2R2 17
#define POS_RH_C2R3 29
#define POS_RH_C2R4 41
#define POS_RH_C2R5 59
#define POS_RH_C2R6 75
#define POS_RH_C3R1 6
#define POS_RH_C3R2 18
#define POS_RH_C3R3 30
#define POS_RH_C3R4 42
#define POS_RH_C3R5 60
#define POS_RH_C3R6 76
#define POS_RH_C4R1 7
#define POS_RH_C4R2 19
#define POS_RH_C4R3 31
#define POS_RH_C4R4 43
#define POS_RH_C4R5 61
#define POS_RH_C4R6 77
#define POS_RH_C5R1 8
#define POS_RH_C5R2 20
#define POS_RH_C5R3 32
#define POS_RH_C5R4 44
#define POS_RH_C5R5 62
#define POS_RH_C5R6 78
#define POS_RH_C6R1 9
#define POS_RH_C6R2 21
#define POS_RH_C6R3 33
#define POS_RH_C6R4 45
#define POS_RH_C6R5 63
#define POS_RH_C6R6 79

/* Custom Defined Behaviors */

/ {
};

/* Automatically generated macro definitions */

/ {
    macros {
        // AutoShift (Assign &AS to a Key) - &AS main macro is chained to &AS_HT hold tap and &AS_Shifted macro - TailorKey

        AS_v1_TKZ: AS_v1_TKZ {
            label = "&AS_V1_TKZ";
            compatible = "zmk,behavior-macro-one-param";
            #binding-cells = <1>;
            tap-ms = <10>;
            wait-ms = <10>;
            bindings =
                <&macro_press>,
                <&macro_param_1to1 &macro_param_1to2 &AS_HT_v1_TKZ MACRO_PLACEHOLDER MACRO_PLACEHOLDER>,
                <&macro_pause_for_release>,
                <&macro_release>,
                <&macro_param_1to1 &macro_param_1to2 &AS_HT_v1_TKZ MACRO_PLACEHOLDER MACRO_PLACEHOLDER>;
        };

        // AutoShift Helper- &AS main macro is chained to &AS_HT hold tap and &AS_Shifted macro - TailorKey

        AS_Shifted_v1_TKZ: AS_Shifted_v1_TKZ {
            label = "&AS_SHIFTED_V1_TKZ";
            compatible = "zmk,behavior-macro-one-param";
            #binding-cells = <1>;
            bindings =
                <&macro_press>,
                <&kp LSHFT>,
                <&macro_tap>,
                <&macro_param_1to1 &kp MACRO_PLACEHOLDER>,
                <&macro_release>,
                <&kp LSHFT>;
        };

        // Cursor Layer - Copy (Ctrl C) - TailorKey

        cur_COPY_v1_TKZ: cur_COPY_v1_TKZ {
            label = "&CUR_COPY_V1_TKZ";
            compatible = "zmk,behavior-macro";
            #binding-cells = <0>;
            bindings = <&kp LC(C)>;
        };

        // Cursor Layer - Cut (Ctrl X) - TailorKey

        cur_CUT_v1_TKZ: cur_CUT_v1_TKZ {
            label = "&CUR_CUT_V1_TKZ";
            compatible = "zmk,behavior-macro";
            #binding-cells = <0>;
            bindings = <&kp LC(X)>;
        };

        // Cursor Layer - Extent Line (seq) - TailorKey

        cur_EXTEND_LINE_v1_TKZ: cur_EXTEND_LINE_v1_TKZ {
            label = "&CUR_EXTEND_LINE_V1_TKZ";
            compatible = "zmk,behavior-macro";
            #binding-cells = <0>;
            tap-ms = <1>;
            wait-ms = <1>;
            bindings = <&kp LS(END)>;
        };

        // Cursor Layer - Extend Word (seq) - TailorKey

        cur_EXTEND_WORD_v1_TKZ: cur_EXTEND_WORD_v1_TKZ {
            label = "&CUR_EXTEND_WORD_V1_TKZ";
            compatible = "zmk,behavior-macro";
            #binding-cells = <0>;
            tap-ms = <1>;
            wait-ms = <1>;
            bindings = <&kp LC(LS(RIGHT))>;
        };

        // Cursor Layer - Find (Ctrl F) - TailorKey

        cur_FIND_v1_TKZ: cur_FIND_v1_TKZ {
            label = "&CUR_FIND_V1_TKZ";
            compatible = "zmk,behavior-macro";
            #binding-cells = <0>;
            bindings = <&kp LC(F)>;
        };

        // Cursor Layer - Find Next (Ctrl G) - TailorKey

        cur_FNEXT_v1_TKZ: cur_FNEXT_v1_TKZ {
            label = "&CUR_FNEXT_V1_TKZ";
            compatible = "zmk,behavior-macro";
            #binding-cells = <0>;
            bindings = <&kp LC(G)>;
        };

        // Cursor Layer - Find Prev (Ctrl Shift G) - TailorKey

        cur_FPREV_v1_TKZ: cur_FPREV_v1_TKZ {
            label = "&CUR_FPREV_V1_TKZ";
            compatible = "zmk,behavior-macro";
            #binding-cells = <0>;
            bindings = <&kp LS(LC(G))>;
        };

        // Cursor Layer - Paste (Ctrl V) - TailorKey

        cur_PASTE_v1_TKZ: cur_PASTE_v1_TKZ {
            label = "&CUR_PASTE_V1_TKZ";
            compatible = "zmk,behavior-macro";
            #binding-cells = <0>;
            bindings = <&kp LC(V)>;
        };

        // Cursor Layer - Redo (Ctrl Y) - TailorKey

        cur_REDO_v1_TKZ: cur_REDO_v1_TKZ {
            label = "&CUR_REDO_V1_TKZ";
            compatible = "zmk,behavior-macro";
            #binding-cells = <0>;
            bindings = <&kp LC(Y)>;
        };

        // Cursor Layer - Selest All (Ctrl A) - TailorKey

        cur_SELECT_ALL_v1_TKZ: cur_SELECT_ALL_v1_TKZ {
            label = "&CUR_SELECT_ALL_V1_TKZ";
            compatible = "zmk,behavior-macro";
            #binding-cells = <0>;
            bindings = <&kp LC(A)>;
        };

        // Cursor Layer - Select Line (seq) - TailorKey

        cur_SELECT_LINE_v1_TKZ: cur_SELECT_LINE_v1_TKZ {
            label = "&CUR_SELECT_LINE_V1_TKZ";
            compatible = "zmk,behavior-macro";
            #binding-cells = <0>;
            tap-ms = <1>;
            wait-ms = <1>;
            bindings = <&kp HOME &kp LS(END)>;
        };

        // Cursor Layer - Select None (seq) - TailorKey

        cur_SELECT_NONE_v1_TKZ: cur_SELECT_NONE_v1_TKZ {
            label = "&CUR_SELECT_NONE_V1_TKZ";
            compatible = "zmk,behavior-macro";
            #binding-cells = <0>;
            tap-ms = <1>;
            wait-ms = <1>;
            bindings = <&kp DOWN &kp UP &kp RIGHT &kp LEFT>;
        };

        // Cursor Layer - Select Word (seq) - TailorKey

        cur_SELECT_WORD_v1_TKZ: cur_SELECT_WORD_v1_TKZ {
            label = "&CUR_SELECT_WORD_V1_TKZ";
            compatible = "zmk,behavior-macro";
            #binding-cells = <0>;
            tap-ms = <1>;
            wait-ms = <1>;
            bindings = <&kp LC(LEFT) &kp LC(LS(RIGHT))>;
        };

        // Cursor Layer - Undo (Ctrl Z) - TailorKey

        cur_UNDO_v1_TKZ: cur_UNDO_v1_TKZ {
            label = "&CUR_UNDO_V1_TKZ";
            compatible = "zmk,behavior-macro";
            #binding-cells = <0>;
            bindings = <&kp LC(Z)>;
        };

        // mod_tab_switcher - TailorKey
        //
        //

        mod_tab_v1_TKZ: mod_tab_v1_TKZ {
            label = "&MOD_TAB_V1_TKZ";
            compatible = "zmk,behavior-macro-one-param";
            #binding-cells = <1>;
            tap-ms = <0>;
            wait-ms = <0>;
            bindings =
                <&macro_press>,
                <&macro_param_1to1 &kp MACRO_PLACEHOLDER>,
                <&macro_tap>,
                <&kp TAB>,
                <&macro_pause_for_release>,
                <&macro_release>,
                <&macro_param_1to1 &kp MACRO_PLACEHOLDER>;
        };

        // mod_tab_switcher_chord -  TailorKey

        mod_tab_chord_v1_TKZ: mod_tab_chord_v1_TKZ {
            label = "&MOD_TAB_CHORD_V1_TKZ";
            compatible = "zmk,behavior-macro-two-param";
            #binding-cells = <2>;
            tap-ms = <0>;
            wait-ms = <0>;
            bindings =
                <&macro_press>,
                <&macro_param_2to1 &mo MACRO_PLACEHOLDER>,
                <&macro_press>,
                <&macro_param_1to1 &mod_tab_v1_TKZ MACRO_PLACEHOLDER>,
                <&macro_pause_for_release>,
                <&macro_release>,
                <&macro_param_1to1 &mod_tab_v1_TKZ MACRO_PLACEHOLDER>,
                <&macro_release>,
                <&macro_param_2to1 &mo MACRO_PLACEHOLDER>;
        };

        // macro string1 sample - Magic Layer F1 - Text output sample macro 1 "¡Hola!" - TailorKey

        mstr1_v1_TKZ: mstr1_v1_TKZ {
            label = "&MSTR1_V1_TKZ";
            compatible = "zmk,behavior-macro";
            #binding-cells = <0>;
            bindings =
                <&macro_press>,
                <&kp RALT>,
                <&macro_tap>,
                <&kp KP_N0 &kp KP_N1 &kp KP_N6 &kp KP_N1>,
                <&macro_release>,
                <&kp RALT>,
                <&macro_press>,
                <&kp LSHFT>,
                <&macro_tap>,
                <&kp H>,
                <&macro_release>,
                <&kp LSHFT>,
                <&macro_tap>,
                <&kp O &kp L &kp A &kp EXCL &kp SPACE &kp RET>;
        };

        // macro string2 sample - Magic Layer F2 - Text output sample macro 2 "grammar check: <paste>" - TailorKey

        mstr2_v1_TKZ: mstr2_v1_TKZ {
            label = "&MSTR2_V1_TKZ";
            compatible = "zmk,behavior-macro";
            #binding-cells = <0>;
            bindings =
                <&macro_tap>,
                <&kp G &kp R &kp A &kp M &kp M &kp A &kp R &kp SPACE &kp C &kp H &kp E &kp C &kp K &kp COLON &kp LC(V) &kp RET>;
        };

        // Cursor Layer - Copy (Cmd C) - TailorKey

        cur_COPY_v1_Mac: cur_COPY_v1_Mac {
            label = "&CUR_COPY_V1_MAC";
            compatible = "zmk,behavior-macro";
            #binding-cells = <0>;
            bindings = <&kp LG(C)>;
        };

        // Cursor Layer - Cut (Cmd X) - TailorKey

        cur_CUT_v1_Mac: cur_CUT_v1_Mac {
            label = "&CUR_CUT_V1_MAC";
            compatible = "zmk,behavior-macro";
            #binding-cells = <0>;
            bindings = <&kp LG(X)>;
        };

        // Cursor Layer - Paste (Cmd V) - TailorKey

        cur_PASTE_v1_Mac: cur_PASTE_v1_Mac {
            label = "&CUR_PASTE_V1_MAC";
            compatible = "zmk,behavior-macro";
            #binding-cells = <0>;
            bindings = <&kp LG(V)>;
        };

        apos: apos {
            label = "&APOS";
            compatible = "zmk,behavior-macro";
            #binding-cells = <0>;
            bindings = <&kp SQT &kp SPACE>;
        };
    };
};

/* Automatically generated behavior definitions */

/ {
    behaviors {
        // AutoShift Helper - &AS main macro is chained to &AS_HT hold tap and &AS_Shifted macro - TailorKey

        AS_HT_v1_TKZ: AS_HT_v1_TKZ {
            compatible = "zmk,behavior-hold-tap";
            #binding-cells = <2>;
            tapping-term-ms = <190>;
            bindings = <&AS_Shifted_v1_TKZ>, <&kp>;
        };

        // thumb_layer_access - TailorKey

        thumb_v1_TKZ: thumb_v1_TKZ {
            compatible = "zmk,behavior-hold-tap";
            #binding-cells = <2>;
            tapping-term-ms = <200>;
            bindings = <&mo>, <&kp>;

            flavor = "tap-preferred";
            quick-tap-ms = <300>;
        };

        // space_layer_access - TailorKey

        space_v1_TKZ: space_v1_TKZ {
            compatible = "zmk,behavior-hold-tap";
            #binding-cells = <2>;
            tapping-term-ms = <200>;
            bindings = <&mo>, <&kp>;

            flavor = "tap-preferred";
            quick-tap-ms = <150>;
        };

        // Homerow Mod for the left hand

        hml: hml {
            compatible = "zmk,behavior-hold-tap";
            #binding-cells = <2>;
            tapping-term-ms = <280>;
            bindings = <&kp>, <&kp>;

            flavor = "balanced";
            quick-tap-ms = <175>;
            require-prior-idle-ms = <150>;
            hold-trigger-key-positions = <6 5 7 8 9 16 19 17 18 20 33 21 32 31 30 29 28 40 41 43 42 45 44 63 62 78 79 77 61 60 76 59 58 75 55 56 72 73 74 57 52 53 54 70 69 71>;
            hold-trigger-on-release;
        };

        // Homerow Mod for the right hand

        hmr: hmr {
            compatible = "zmk,behavior-hold-tap";
            #binding-cells = <2>;
            tapping-term-ms = <280>;
            bindings = <&kp>, <&kp>;

            flavor = "balanced";
            quick-tap-ms = <175>;
            require-prior-idle-ms = <150>;
            hold-trigger-key-positions = <55 56 72 73 74 57 52 53 54 70 69 71 0 1 2 3 4 15 14 13 12 11 10 22 23 24 25 27 26 38 39 50 51 68 67 49 37 36 48 66 65 47 35 34 46 64>;
            hold-trigger-on-release;
        };
    };
};

/* Automatically generated combos definitions */

/ {
    combos {
        compatible = "zmk,combos";

        // Calls macro tab_switcher_gui_combo on Left T1/T4 - TailorKey

        combo_alt_tab_switch_v1_TKZ {
            key-positions = <69 52>;
            bindings = <&mod_tab_chord_v1_TKZ LALT 5>;
        };

        // capslock when pressing both T1's - TailorKey

        combo_capslock_v1_TKZ {
            key-positions = <52 57>;
            bindings = <&kp CAPS>;
        };

        // capsword on LH_T1 and LH_C2R4 - TailorKey

        combo_capsword_left_v1_TKZ {
            timeout-ms = <50>;
            key-positions = <38 52>;
            bindings = <&caps_word>;
        };

        // capsword on RH_T1 and RH_C2R4 - TailorKey

        combo_capsword_right_v1_TKZ {
            timeout-ms = <50>;
            key-positions = <57 41>;
            bindings = <&caps_word>;
        };

        // Calls macro tab_switcher_ctrl_combo on Left T4/T5 - TailorKey

        combo_ctrl_tab_switch_v1_TKZ {
            timeout-ms = <51>;
            key-positions = <69 70>;
            bindings = <&mod_tab_chord_v1_TKZ LCTRL 5>;
        };

        // F11 on RH_C5 and RH_R1+R2 - TailorKey

        combo_F11_v1_TKZ {
            key-positions = <8 20>;
            bindings = <&kp F11>;
        };

        // F12 on RH_C6 and RH_R1+R2 - TailorKey

        combo_F12_v1_TKZ {
            key-positions = <9 21>;
            bindings = <&kp F12>;
        };

        // toggle gaming layer - TailorKey

        combo_gaming_layer_v1_TKZ {
            key-positions = <54 71>;
            bindings = <&tog 7>;
        };

        // sticky "hyper" modifiers (Alt + Ctrl + Shift) - TailorKey

        combo_sticky_hyp_rght_v1_TKZ {
            timeout-ms = <50>;
            key-positions = <74 57>;
            bindings = <&sk LG(LA(LC(LSHFT)))>;
        };

        // sticky "meh" modifiers (Alt + Ctrl + Shift) - TailorKey

        combo_sticky_meh_rght_v1_TKZ {
            timeout-ms = <50>;
            key-positions = <73 74>;
            bindings = <&sk LA(LC(LSHFT))>;
        };

        combo_EscWF {
            key-positions = <24 25>;
            bindings = <&kp ESC>;
        };

        combo_copy {
            key-positions = <49 48>;
            bindings = <&cur_COPY_v1_TKZ>;
            layers = <0 2 3 4 5 6 7>;
        };

        combo_cut {
            key-positions = <48 50>;
            bindings = <&cur_CUT_v1_TKZ>;
            layers = <0 2 3 4 5 6 7>;
        };

        combo_paste {
            key-positions = <50 49>;
            bindings = <&cur_PASTE_v1_TKZ>;
            layers = <0 2 3 4 5 6 7>;
        };

        combo_copy_mac {
            key-positions = <49 48>;
            bindings = <&cur_COPY_v1_Mac>;
            layers = <1>;
        };

        combo_cut_mac {
            key-positions = <48 50>;
            bindings = <&cur_CUT_v1_Mac>;
            layers = <1>;
        };

        combo_paste_mac {
            key-positions = <50 49>;
            bindings = <&cur_PASTE_v1_Mac>;
            layers = <1>;
        };
    };
};

/* Automatically generated keymap */

/ {
    keymap {
        compatible = "zmk,keymap";

        layer_Base {
            bindings = <
&kp F1                &kp F2        &kp F3       &kp F4       &kp F5                                                                                                               &kp F6        &kp F7       &kp F8       &kp F9        &kp F10
&kp EQUAL             &kp N1        &kp N2       &kp N3       &kp N4        &kp N5                                                                                         &kp N6  &kp N7        &kp N8       &kp N9       &kp N0        &kp MINUS
&kp ESC               &kp Q         &kp W        &kp F        &kp P         &kp B                                                                                          &kp J   &kp L         &kp U        &kp Y        &kp SEMI      &kp BSLH
&kp TAB               &hml LSHFT A  &hml LALT R  &hml LGUI S  &hml LCTRL T  &kp G                                                                                          &kp M   &hmr LCTRL N  &hmr LGUI E  &hmr LALT I  &hmr RSHFT O  &apos
&kp GRAVE             &kp Z         &kp X        &kp C        &kp D         &kp V   &kp LSHFT             &kp LCTRL  &lower    &kp LGUI  &kp RCTRL  &kp RSHFT              &kp K   &kp H         &kp COMMA    &kp DOT      &kp FSLH      &kp PG_UP
&magic LAYER_Magic 0  &kp HOME      &kp END      &kp LEFT     &kp RIGHT             &thumb_v1_TKZ 6 BSPC  &kp DEL    &kp LALT  &kp RALT  &kp RET    &space_v1_TKZ 6 SPACE          &kp UP        &kp DOWN     &kp LBKT     &kp RBKT      &kp PG_DN
            >;
        };

        layer_MacOS {
            bindings = <
&trans  &trans  &trans  &trans        &trans                                                                       &trans       &trans        &trans  &trans  &trans
&trans  &trans  &trans  &trans        &trans       &trans                                                  &trans  &trans       &trans        &trans  &trans  &trans
&trans  &trans  &trans  &trans        &trans       &trans                                                  &trans  &trans       &trans        &trans  &trans  &trans
&trans  &trans  &trans  &hml LCTRL S  &hml LGUI T  &trans                                                  &trans  &hmr LGUI N  &hmr LCTRL E  &trans  &trans  &trans
&trans  &trans  &trans  &trans        &trans       &trans  &trans  &trans  &trans  &trans  &trans  &trans  &trans  &trans       &trans        &trans  &trans  &trans
&trans  &trans  &trans  &trans        &trans               &trans  &trans  &trans  &trans  &trans  &trans          &trans       &trans        &trans  &trans  &trans
            >;
        };

        layer_Typing {
            bindings = <
&trans                &trans  &trans  &trans  &trans                                                                  &trans  &trans     &trans    &trans    &trans
&kp EQUAL             &kp N1  &kp N2  &kp N3  &kp N4  &kp N5                                                  &kp N6  &kp N7  &kp N8     &kp N9    &kp N0    &kp MINUS
&trans                &kp Q   &kp W   &kp F   &kp P   &kp B                                                   &kp J   &kp L   &kp U      &kp Y     &kp SEMI  &kp BSLH
&trans                &kp A   &kp R   &kp S   &kp T   &kp G                                                   &kp M   &kp N   &kp E      &kp I     &kp O     &kp SQT
&kp GRAVE             &kp Z   &kp X   &kp C   &kp D   &kp V   &trans  &trans  &trans  &trans  &trans  &trans  &kp K   &kp H   &kp COMMA  &kp DOT   &kp FSLH  &trans
&magic LAYER_Magic 0  &trans  &trans  &trans  &trans          &trans  &trans  &trans  &trans  &trans  &trans          &trans  &trans     &kp LBKT  &kp RBKT  &trans
            >;
        };

        layer_Lower {
            bindings = <
&kp C_BRI_DN          &kp C_BRI_UP  &kp C_PREV      &kp C_NEXT      &kp C_PP                                                                                           &kp C_MUTE  &kp C_VOL_DN  &kp C_VOL_UP  &none            &kp PAUSE_BREAK
&trans                &none         &none           &none           &none            &kp HOME                                                   &kp LEFT_PARENTHESIS   &kp KP_NUM  &kp KP_EQUAL  &kp KP_SLASH  &kp KP_MULTIPLY  &kp PRINTSCREEN
&trans                &none         &none           &kp UP_ARROW    &none            &kp END                                                    &kp RIGHT_PARENTHESIS  &kp KP_N7   &kp KP_N8     &kp KP_N9     &kp KP_MINUS     &kp SCROLLLOCK
&trans                &none         &kp LEFT_ARROW  &kp DOWN_ARROW  &kp RIGHT_ARROW  &kp PG_UP                                                  &kp PERCENT            &kp KP_N4   &kp KP_N5     &kp KP_N6     &kp KP_PLUS      &none
&trans                &kp K_APP     &none           &kp F11         &kp F12          &kp PG_DN  &trans  &trans  &to 0   &trans  &trans  &trans  &kp COMMA              &kp KP_N1   &kp KP_N2     &kp KP_N3     &kp KP_ENTER     &trans
&magic LAYER_Magic 0  &kp CAPS      &kp INS         &kp F11         &kp F12                     &trans  &trans  &trans  &trans  &trans  &to 6                          &kp KP_N0   &kp KP_N0     &kp KP_DOT    &kp KP_ENTER     &trans
            >;
        };

        layer_Magic {
            bindings = <
&mstr1_v1_TKZ  &mstr2_v1_TKZ    &none            &none            &none                                                                                     &none  &none  &none  &bt BT_CLR  &bt BT_CLR_ALL
&to 0          &to 1            &to 2            &to 3            &to 4            &to 5                                                             &to 6  &to 7  &none  &none  &none       &none
&none          &rgb_ug RGB_SPI  &rgb_ug RGB_SAI  &rgb_ug RGB_HUI  &rgb_ug RGB_BRI  &rgb_ug RGB_TOG                                                   &none  &none  &none  &none  &none       &none
&bootloader    &rgb_ug RGB_SPD  &rgb_ug RGB_SAD  &rgb_ug RGB_HUD  &rgb_ug RGB_BRD  &rgb_ug RGB_EFF                                                   &none  &none  &none  &none  &none       &bootloader
&sys_reset     &none            &none            &none            &none            &none            &bt_2  &bt_3  &none         &none  &none  &none  &none  &none  &none  &none  &none       &sys_reset
&none          &none            &none            &none            &none                             &bt_0  &bt_1  &out OUT_USB  &none  &none  &none         &none  &none  &none  &none       &none
            >;
        };

        layer_Cursor {
            bindings = <
&none                 &none                   &none                    &none                    &none                                                                                                                                                                                       &none             &none              &none              &none      &none
&kp ESC               &kp RET                 &kp SPACE                &kp TAB                  &kp DEL            &kp INS                                                                                                                                               &kp INS            &kp DEL           &kp TAB            &kp SPACE          &kp RET    &kp ESC
&kp LC(E)             &sk LSHFT               &cur_REDO_v1_TKZ         &cur_UNDO_v1_TKZ         &kp BSPC           &cur_CUT_v1_TKZ                                                                                                                                       &cur_CUT_v1_TKZ    &kp BSPC          &cur_UNDO_v1_TKZ   &cur_REDO_v1_TKZ   &sk LSHFT  &kp LC(K)
&kp LC(L)             &kp LGUI                &kp LALT                 &kp LCTRL                &kp LSHFT          &cur_COPY_v1_TKZ                                                                                                                                      &cur_COPY_v1_TKZ   &kp LEFT          &kp UP             &kp DOWN           &kp RIGHT  &kp LC(L)
&kp LC(J)             &cur_SELECT_ALL_v1_TKZ  &cur_SELECT_LINE_v1_TKZ  &cur_SELECT_WORD_v1_TKZ  &cur_FIND_v1_TKZ   &cur_PASTE_v1_TKZ  &mod_tab_v1_TKZ LALT  &mod_tab_v1_TKZ LGUI   &kp PSCRN  &cur_SELECT_NONE_v1_TKZ  &cur_EXTEND_LINE_v1_TKZ  &cur_EXTEND_WORD_v1_TKZ  &cur_PASTE_v1_TKZ  &kp HOME          &kp PG_UP          &kp PG_DN          &kp END    &kp LC(J)
&magic LAYER_Magic 0  &cur_FPREV_v1_TKZ       &cur_EXTEND_LINE_v1_TKZ  &cur_EXTEND_WORD_v1_TKZ  &cur_FNEXT_v1_TKZ                     &none                 &mod_tab_v1_TKZ LCTRL  &kp LG(D)  &cur_SELECT_ALL_v1_TKZ   &cur_SELECT_LINE_v1_TKZ  &cur_SELECT_WORD_v1_TKZ                     &cur_FIND_v1_TKZ  &cur_FPREV_v1_TKZ  &cur_FNEXT_v1_TKZ  &kp LC(H)  &kp LG(DOT)
            >;
        };

        layer_Symbol {
            bindings = <
&none  &none      &none     &none     &none                                                                                     &none   &none    &none   &none      &none
&none  &none      &none     &none     &none      &none                                                               &kp STAR   &none   &none    &none   &none      &none
&none  &kp EXCL   &kp AT    &kp LBRC  &kp RBRC   &kp PIPE                                                            &kp PLUS   &kp N7  &kp N8   &kp N9  &kp STAR   &none
&none  &kp HASH   &kp DLLR  &kp LPAR  &kp RPAR   &kp CARET                                                           &kp MINUS  &kp N4  &kp N5   &kp N6  &kp GRAVE  &kp APOS
&none  &kp PRCNT  &kp AMPS  &kp LBKT  &kp RBKT   &kp TILDE  &kp BSLH  &kp DOT    &kp STAR  &none  &none   &kp BSPC   &kp EQUAL  &kp N1  &kp N2   &kp N3  &none      &none
&none  &none      &none     &none     &kp UNDER             &kp BSPC  &kp COLON  &kp SEMI  &to 0  &trans  &kp SPACE             &trans  &kp DOT  &kp N0  &trans     &none
            >;
        };

        layer_Gaming {
            bindings = <
&trans     &trans     &trans  &trans  &trans                                                                                    &trans  &trans  &trans     &trans   &trans
&trans     &trans     &trans  &trans  &trans  &trans                                                                    &trans  &trans  &trans  &trans     &trans   &trans
&kp MINUS  &kp GRAVE  &kp B   &kp N   &kp M   &kp SQT                                                                   &kp B   &kp N   &kp M   &kp COMMA  &kp DOT  &kp FSLH
&kp T      &kp TAB    &kp Q   &kp W   &kp E   &kp R                                                                     &kp T   &kp Y   &kp U   &kp I      &kp O    &kp P
&kp G      &kp LSHFT  &kp A   &kp S   &kp D   &kp F    &kp ESC    &kp RET   &kp PAUSE_BREAK  &kp BSPC  &kp DEL  &trans  &kp G   &kp H   &kp J   &kp K      &kp L    &kp SEMI
&kp V      &kp LCTRL  &kp Z   &kp X   &kp C            &kp SPACE  &kp LALT  &kp LGUI         &to 0     &trans   &trans          &trans  &trans  &trans     &trans   &trans
            >;
        };
    };
};
